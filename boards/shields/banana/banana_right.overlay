#include "banana.dtsi"

&spi1 {
    compatible = "nordic,nrf-spi";
    status = "okay";
    pinctrl-0 = <&spi1_default_alt>;
    pinctrl-1 = <&spi1_sleep_alt>;
    pinctrl-names = "default", "sleep";
    cs-gpios = <&gpio0 24 (GPIO_ACTIVE_LOW | GPIO_PULL_UP)>;

    pmw3366: pmw3366@0 {
            compatible = "pixart,pmw3366";
            reg = <0>;
            irq-gpios = <&gpio0 11 (GPIO_ACTIVE_LOW | GPIO_PULL_UP)>;
            spi-max-frequency = <1000000>;
        
    };
};

&default_transform { // Offset of 5 because the left side has 5 columns
    col-offset = <5>;
};

&trackball_split {
    device = <&pmw3366>;
    status = "okay";
};