## boards/shields/banana/Kconfig.defconfig
```kconfig
if SHIELD_BANANA_LEFT

# Name must be less than 16 characters long!
config ZMK_KEYBOARD_NAME
    default "Banana"

config ZMK_SPLIT_BLE_ROLE_CENTRAL
    default y
endif

if SHIELD_BANANA_LEFT || SHIELD_BANANA_RIGHT

config ZMK_POINTING
    default y

config SPI
    default y    
endif

if SHIELD_BANANA_RIGHT

config PMW3360_LOG_LEVEL_DBG
    default y

config PMW3360_LOG_LEVEL_INF
    default y
```

## config/west.yml
```yaml
manifest:
  remotes:

    - name: zmkfirmware
      url-base: https://github.com/zmkfirmware
    - name: maximoh-mmo
      url-base: https://github.com/maximoh-mmo
    - name: bullwinkle3000
      url-base: https://github.com/bullwinkle3000
    # Additional modules containing boards/shields/custom code can be listed here as well
    # See https://docs.zephyrproject.org/3.2.0/develop/west/manifest.html#projects
  projects:
    - name: zmk
      remote: zmkfirmware
      revision: main
      import: app/west.yml

    - name: zmk-pmw3610-driver
      remote: bullwinkle3000
      revision: pmw3360
    
    #- name: zmk-pmw3360-driver
    #  remote: maximoh-mmo
    #  revision: main
  self:
    path: config
```
